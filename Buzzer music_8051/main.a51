RELOAD_H EQU R4
RELOAD_L EQU R5
DONEFLAG EQU 00H
COUNT_REGISTER EQU R7

; ------------------------
; Macros for playing sounds
; ------------------------

LOAD_TIMER MACRO H_VAL, L_VAL
    MOV TH0, #H_VAL
    MOV TL0, #L_VAL
ENDM

PLAY_100HZ MACRO REPEAT_COUNT
	MOV A, REPEAT_COUNT
	MOV R6, #1
	MOV COUNT_REGISTER, REPEAT_COUNT
	LOAD_TIMER 0EEH, 00H
	ACALL RUN_FREQ
ENDM

PLAY_200HZ MACRO REPEAT_COUNT
	MOV A, REPEAT_COUNT
	MOV R6, #2
	MOV COUNT_REGISTER, REPEAT_COUNT
	LOAD_TIMER 0F7H, 00H
	ACALL RUN_FREQ
ENDM

PLAY_300HZ MACRO REPEAT_COUNT
	MOV A, REPEAT_COUNT
	MOV R6, #3
	MOV COUNT_REGISTER, REPEAT_COUNT
	MOV RELOAD_H, #0FAH
	MOV RELOAD_L, #000H
	ACALL RUN_FREQ
ENDM

PLAY_400HZ MACRO REPEAT_COUNT
	MOV A, REPEAT_COUNT
    MOV R6, #4
    MOV COUNT_REGISTER, REPEAT_COUNT
    MOV RELOAD_H, #0FBH
    MOV RELOAD_L, #080H
    ACALL RUN_FREQ
ENDM

PLAY_500HZ MACRO REPEAT_COUNT
	MOV A, REPEAT_COUNT
    MOV R6, #5
    MOV COUNT_REGISTER, REPEAT_COUNT
    MOV RELOAD_H, #0FCH
    MOV RELOAD_L, #066H
    ACALL RUN_FREQ
ENDM

PLAY_600HZ MACRO REPEAT_COUNT
	MOV A, REPEAT_COUNT
    MOV R6, #6
    MOV COUNT_REGISTER, REPEAT_COUNT
    MOV RELOAD_H, #0FDH
    MOV RELOAD_L, #000H
    ACALL RUN_FREQ
ENDM

PLAY_700HZ MACRO REPEAT_COUNT
	MOV A, REPEAT_COUNT
    MOV R6, #7
    MOV COUNT_REGISTER, REPEAT_COUNT
    MOV RELOAD_H, #0FDH
    MOV RELOAD_L, #06EH
    ACALL RUN_FREQ
ENDM

PLAY_800HZ MACRO REPEAT_COUNT
	MOV A, REPEAT_COUNT
    MOV R6, #8
    MOV COUNT_REGISTER, REPEAT_COUNT
    MOV RELOAD_H, #0FDH
    MOV RELOAD_L, #0C0H
    ACALL RUN_FREQ
ENDM

PLAY_900HZ MACRO REPEAT_COUNT
	MOV A, REPEAT_COUNT
    MOV R6, #9
    MOV COUNT_REGISTER, REPEAT_COUNT
    MOV RELOAD_H, #0FEH
    MOV RELOAD_L, #000H
    ACALL RUN_FREQ
ENDM

PLAY_1000HZ MACRO REPEAT_COUNT
	MOV A, REPEAT_COUNT
    MOV R6, #10
    MOV COUNT_REGISTER, REPEAT_COUNT
    MOV RELOAD_H, #0FEH
    MOV RELOAD_L, #033H
    ACALL RUN_FREQ
ENDM

PLAY_1100HZ MACRO REPEAT_COUNT
	MOV A, REPEAT_COUNT
    MOV R6, #11
    MOV COUNT_REGISTER, REPEAT_COUNT
    MOV RELOAD_H, #0FEH
    MOV RELOAD_L, #05DH
    ACALL RUN_FREQ
ENDM

PLAY_1200HZ MACRO REPEAT_COUNT
	MOV A, REPEAT_COUNT
    MOV R6, #12
    MOV COUNT_REGISTER, REPEAT_COUNT
    MOV RELOAD_H, #0FEH
    MOV RELOAD_L, #080H
    ACALL RUN_FREQ
ENDM

PLAY_1300HZ MACRO REPEAT_COUNT
	MOV A, REPEAT_COUNT
    MOV R6, #13
    MOV COUNT_REGISTER, REPEAT_COUNT
    MOV RELOAD_H, #0FEH
    MOV RELOAD_L, #09EH
    ACALL RUN_FREQ
ENDM

PLAY_1400HZ MACRO REPEAT_COUNT
	MOV A, REPEAT_COUNT
    MOV R6, #14
    MOV COUNT_REGISTER, REPEAT_COUNT
    MOV RELOAD_H, #0FEH
    MOV RELOAD_L, #0B7H
    ACALL RUN_FREQ
ENDM

PLAY_1500HZ MACRO REPEAT_COUNT
	MOV A, REPEAT_COUNT
    MOV R6, #15
    MOV COUNT_REGISTER, REPEAT_COUNT
    MOV RELOAD_H, #0FEH
    MOV RELOAD_L, #0CDH
    ACALL RUN_FREQ
ENDM

PLAY_1600HZ MACRO REPEAT_COUNT
	MOV A, REPEAT_COUNT
    MOV R6, #15
    MOV COUNT_REGISTER, REPEAT_COUNT
    MOV RELOAD_H, #0FEH
    MOV RELOAD_L, #0E0H
    ACALL RUN_FREQ
ENDM

ORG 0000H
LJMP MAIN

ORG 000BH
LJMP TO_ISR

ORG 0050H
MAIN:
	MOV TMOD, #01H		; Timer0 mode 1
	MOV IE, #82H		; Enable Timer0 interrupt, EA=1
	MOV P2, #00H		; Clear port
	
PLAY:
	PLAY_100HZ #50
	PLAY_200HZ #50
	PLAY_300HZ #50
	PLAY_400HZ #50
	PLAY_500HZ #50
	PLAY_600HZ #50
	PLAY_700HZ #50
	PLAY_800HZ #50
	PLAY_900HZ #50
	PLAY_1000HZ #50
	PLAY_1100HZ #50
	PLAY_1200HZ #50
	PLAY_1300HZ #50
	PLAY_1400HZ #50
	PLAY_1500HZ #50
	PLAY_1600HZ #50
	PLAY_1600HZ #200
	
	MOV IE, #00H
	
	SJMP $
	;LJMP PLAY
	

; ------------------------
; Subroutine: RUN_FREQ
; Wait until DONEFLAG is set
; ------------------------
RUN_FREQ:
	CLR DONEFLAG
	MOV TH0, RELOAD_H
	MOV TL0, RELOAD_L
	SETB TR0
WAIT_DONE:
	JNB DONEFLAG, WAIT_DONE
	RET

; ------------------------
; Subroutine: TO_ISR
; Interupt Sequence
; ------------------------
TO_ISR:
	;CLR TR0
	;CLR TF0
	CPL P2.5			; Toggle buzzer pin
	MOV TH0, RELOAD_H
	MOV TL0, RELOAD_L
	DJNZ COUNT_REGISTER, CONTINUE
	DJNZ R6, R7_RESET
	SETB DONEFLAG
R7_RESET:
	MOV COUNT_REGISTER, A
CONTINUE:
	;SETB TR0
	RETI

	
END